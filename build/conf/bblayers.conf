## build/conf/bblayers.conf
```bitbake
# POKY_BBLAYERS_CONF_VERSION is increased each time build/conf/bblayers.conf
# changes incompatibly
POKY_BBLAYERS_CONF_VERSION = "2"

BBPATH = "${TOPDIR}"
BBFILES ?= ""

BBLAYERS ?= " \
  /workdir/rpi5-yocto/poky/meta \
  /workdir/rpi5-yocto/poky/meta-poky \
  /workdir/rpi5-yocto/poky/meta-yocto-bsp \
  /workdir/rpi5-yocto/layers/meta-openembedded/meta-oe \
  /workdir/rpi5-yocto/layers/meta-openembedded/meta-networking \
  /workdir/rpi5-yocto/layers/meta-openembedded/meta-python \
  /workdir/rpi5-yocto/layers/meta-raspberrypi \
  /workdir/rpi5-yocto/layers/meta-qt6 \ 
  /workdir/rpi5-yocto/layers/meta-rpi5 \
  "
```
